## base_external/Config.in
```kconfig
source "$BR2_EXTERNAL_aeld_base_PATH/package/aesd-assignments/Config.in"
source "$BR2_EXTERNAL_aeld_base_PATH/package/ldd/Config.in"
```

## base_external/package/ldd/Config.in
```kconfig
config BR2_PACKAGE_LDD
    bool "LDD kernel modules"
    help
      Kernel modules provided in the LDD3 repository (used in Coursera
      buildroot and yocto course).
      
      https://github.com/cu-ecen-aeld/assignment-7-amasini0.git
```
